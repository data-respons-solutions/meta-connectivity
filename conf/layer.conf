## conf/layer.conf
```bitbake
# We have a conf and classes directory, add to BBPATH
BBPATH .= ":${LAYERDIR}"

# We have a packages directory, add to BBFILES
BBFILES += "${LAYERDIR}/recipes-*/*/*.bb \
            ${LAYERDIR}/recipes-*/*/*.bbappend"

BBFILE_COLLECTIONS += "connectivity-layer"
BBFILE_PATTERN_connectivity-layer := "^${LAYERDIR}/"
BBFILE_PRIORITY_connectivity-layer = "6"

LAYERDEPENDS_connectivity-layer = "core"
LAYERSERIES_COMPAT_connectivity-layer = "warrior"

# Let us add layer-specific bbappends which are only applied when that
# layer is included in our configuration
BBFILES += "${@' '.join('${LAYERDIR}/%s/recipes*/*/*.bbappend' % layer \
               for layer in BBFILE_COLLECTIONS.split())}"
```
